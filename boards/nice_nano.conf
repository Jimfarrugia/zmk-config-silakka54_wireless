## boards/nice_nano.conf
```kconfig
CONFIG_ZMK_DISPLAY=y
CONFIG_ZMK_WIDGET_LAYER_STATUS=y
CONFIG_ZMK_WIDGET_BATTERY_STATUS=y
CONFIG_ZMK_WIDGET_OUTPUT_STATUS=y

CONFIG_SSD1306=y

CONFIG_I2C=y
CONFIG_I2C_INIT_PRIORITY=60

CONFIG_SSD1306_128X32=y
```
