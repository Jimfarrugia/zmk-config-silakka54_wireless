&oled {
    compatible = "solomon,ssd1306fb";
    width = <128>;
    height = <32>;
    segment-offset = <0>;
    page-offset = <0>;
    display-offset = <0>;
    multiplex-ratio = <31>;
    prechargep = <2>;
    clock-frequency = <0x8000>;
};
